## Documentation/devicetree/bindings/power/supply/qcom,pm6150-charger.yaml
```yaml
# SPDX-License-Identifier: (GPL-2.0-only OR BSD-2-Clause)
%YAML 1.2
---
$id: http://devicetree.org/schemas/power/supply/qcom,pm6150-charger.yaml#
$schema: http://devicetree.org/meta-schemas/core.yaml#

title: Qualcomm PM6150 Switch-Mode Battery Charger

maintainers:
  - Alexis Barron Luna <alexis.barron.luna@gmail.com>

description:
  The Qualcomm PM6150 SMB5 charger hardware manages battery charging and USB
  input current limiting on Qualcomm PM6150 PMICs.

properties:
  compatible:
    const: qcom,pm6150-charger

  reg:
    maxItems: 1

  interrupts:
    minItems: 1
    maxItems: 7

  interrupt-names:
    minItems: 1
    items:
      - const: usb-plugin
      - const: usbin-icl-change
      - const: bat-ov
      - const: wdog-bark
      - const: chg-state-change
      - const: usbin-src-change
      - const: bat-temp

  io-channels:
    minItems: 1
    maxItems: 2

  io-channel-names:
    minItems: 1
    items:
      - const: usbin_i
      - const: usbin_v

  power-supplies:
    maxItems: 1
    description:
      Phandle to the Type-C port power supply delivering the negotiated input current budget.

  input-current-limit-microamp:
    description:
      Maximum USB input current limit in microamperes supported by the board.
    minimum: 50000
    maximum: 3000000
    multipleOf: 50000

  monitored-battery:
    description:
      Phandle to the simple-battery node containing battery design characteristics.

required:
  - compatible
  - reg
  - monitored-battery

allOf:
  - $ref: power-supply.yaml#

additionalProperties: false

examples:
  - |
    #include <dt-bindings/interrupt-controller/irq.h>

    pmic {
      #address-cells = <1>;
      #size-cells = <0>;

      charger@1000 {
        compatible = "qcom,pm6150-charger";
        reg = <0x1000>;

        interrupts = <0x0 0x13 0x04 IRQ_TYPE_EDGE_BOTH>,
                     <0x0 0x13 0x07 IRQ_TYPE_EDGE_RISING>,
                     <0x0 0x12 0x02 IRQ_TYPE_EDGE_BOTH>,
                     <0x0 0x16 0x01 IRQ_TYPE_EDGE_RISING>,
                     <0x0 0x10 0x01 IRQ_TYPE_EDGE_RISING>,
                     <0x0 0x13 0x06 IRQ_TYPE_EDGE_RISING>,
                     <0x0 0x12 0x00 IRQ_TYPE_EDGE_RISING>;
        interrupt-names = "usb-plugin", "usbin-icl-change",
                          "bat-ov", "wdog-bark",
                          "chg-state-change", "usbin-src-change", "bat-temp";

        io-channels = <&pm6150_adc 7>,
                      <&pm6150_adc 8>;
        io-channel-names = "usbin_i", "usbin_v";

        power-supplies = <&pm6150_typec>;
        input-current-limit-microamp = <1800000>;
        monitored-battery = <&battery>;
      };
    };
```

## Documentation/devicetree/bindings/power/supply/qcom,pm6150-qg.yaml
```yaml
# SPDX-License-Identifier: (GPL-2.0-only OR BSD-2-Clause)
%YAML 1.2
---
$id: http://devicetree.org/schemas/power/supply/qcom,pm6150-qg.yaml#
$schema: http://devicetree.org/meta-schemas/core.yaml#

title: Qualcomm PM6150 QGauge

maintainers:
  - Alexis Barron Luna <alexis.barron.luna@gmail.com>

description:
  Battery voltage and current measurement peripheral of PM6150. Battery
  temperature is measured through the PMIC ADC. SDAM holds saved gauge data.
  The charger supplies the battery and provides its charging status.

allOf:
  - $ref: power-supply.yaml#
  - if:
      properties:
        interrupts:
          minItems: 2
      required:
        - interrupts
    then:
      properties:
        interrupt-names:
          minItems: 2
    else:
      properties:
        interrupt-names:
          maxItems: 1

properties:
  compatible:
    const: qcom,pm6150-qg

  reg:
    maxItems: 1

  interrupts:
    minItems: 1
    items:
      - description: FIFO sample batch ready
      - description: Qualified open-circuit voltage available

  interrupt-names:
    minItems: 1
    items:
      - const: fifo-done
      - const: good-ocv

  io-channels:
    minItems: 1
    maxItems: 2

  io-channel-names:
    minItems: 1
    items:
      - const: batt-therm
      - const: batt-id

  nvmem:
    maxItems: 1

  monitored-battery: true

  power-supplies:
    maxItems: 1
    description: Charger supplying the monitored battery.

required:
  - compatible
  - reg
  - io-channels
  - io-channel-names
  - nvmem
  - monitored-battery

additionalProperties: false

dependentRequired:
  interrupts: [interrupt-names]
  interrupt-names: [interrupts]

examples:
  - |
    pmic {
        #address-cells = <1>;
        #size-cells = <0>;

        battery@4800 {
            compatible = "qcom,pm6150-qg";
            reg = <0x4800>;
            interrupts = <0 0x48 3 1>, <0 0x48 4 1>;
            interrupt-names = "fifo-done", "good-ocv";
            io-channels = <&pm6150_adc 0x4a>, <&pm6150_adc 0x4b>;
            io-channel-names = "batt-therm", "batt-id";
            nvmem = <&pm6150_qg_sdam>;
            monitored-battery = <&battery>;
            power-supplies = <&pm6150_charger>;
        };
    };
```
